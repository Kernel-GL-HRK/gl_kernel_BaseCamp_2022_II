/dts-v1/;
/plugin/;

/ {
    fragment@0 {
        target = <&spi0>;

        __overlay__ {
            #address-cells = <1>;
            #size-cells = <0>;
            status = "okay";

            st7735@0 {
                compatible = "my_st7735";
                reg = <0>;
                spi-max-frequency = <32000000>;
                reset-gpios = <&gpio 25 0x0000>;
                dc-gpios = <&gpio 24 0x0000>;
                pinctrl-names = "default";
                pinctrl-0 = <&spi0_cs0>;

                modalias = "my_st7735";

                spi0_cs0: spi0_cs0 {
                    brcm,pins = <8>;
                    brcm,function = <1>; 
                };
            };
        };
    };
};