/dts-v1/;
/plugin/;
/ {
	compatible = "brcm,bcm2835";
	fragment@0 {
		target-path = "/";
		__overlay__ {
			RGB_leds {
				compatible = "brightlight,mydev,RGB";
				red-led = <2>;
				green-led = <3>;
				blue-led = <4>;
			};
		};
	};
};