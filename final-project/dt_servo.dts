/dts-v1/;
/plugin/;

/ {
	compatible = "brcm, bcm2835";
	fragment@0 {
		target-path = "/";
		__overlay__ {
			servo {
				compatible = "servo, SG-90";
				pwm-channel = <0>;
				mode = "absolute"; //absolute or relative
			};
		};
	};
};